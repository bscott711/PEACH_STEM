## sdkconfig.defaults
```kconfig
# Start Arduino inside IDF
CONFIG_AUTOSTART_ARDUINO=y

# RTOS tick = 1ms
CONFIG_FREERTOS_HZ=1000

# Necessary for vTaskGetRunTimeStats()
CONFIG_FREERTOS_USE_TRACE_FACILITY=y
CONFIG_FREERTOS_GENERATE_RUN_TIME_STATS=y
CONFIG_FREERTOS_USE_STATS_FORMATTING_FUNCTIONS=y
```
